## Kconfig
```kconfig
# Copyright (c) 2023 EPAM Systems
# SPDX-License-Identifier: Apache-2.0

mainmenu "OPTEE Library"

config OPTEE_CLIENT
	bool "Enable optee-client"
	help
	  Enable OP-TEE client libraries. Application can use this
	  library for use OP-TEE capabilities and services. This
	  includes libteec, libckteec, libseteec, libteecacl libraries
	  and tee supplicant

if OPTEE_CLIENT

config OPTEE_LIBTEEC
	bool "Enable libteec"
	help
	  Enable libteec library. Basic library for other OP-TEE
	  client libraries. This library performes calls to OP-TEE.
	  Library also provides basic function for allocate/release
	  shared with OP-TEE memory

config OPTEE_LIBCKTEEC
	bool "Enable libckteec"
	depends on OPTEE_LIBTEEC
	help
	  This library gives ability to use Public-key Cryptography
	  Standards #11 (PKCS #11).
	  API provided by loadable trusted application. This application
	  is loaded during library initialization procedure.

config OPTEE_TEE_SUPPLICANT
	bool "Enable build of TEE Supplicant"
	depends on OPTEE_LIBTEEC
	help
	  tee-supplicant is intermediary between OP-TEE and application.
	  It allocates memory in application for OP-TEE, loads trusted
	  applications from application and perform file system operation
	  on non-volatile memory devices which inaccessible from OP-TEE

config OPTEE_STORAGE_ROOT
	string "Storage root directory"
	default "/tee"
	depends on OPTEE_TEE_SUPPLICANT
	help
	  tee_supplicant needs directory where it will keep temporary
	  files. This directory should be existent and file system
	  mounted.

config OPTEE_LIBSETEEC
	bool "Enable libseteec"
	depends on OPTEE_LIBTEEC
	select POSIX_API
	help
	  libseteec stands for secure element control. A Secure Element (SE)
	  is a tamper-resistant platform capable of securely hosting
	  applications and their confidential and cryptographic data
	  (e.g. key management) in accordance with the rules and security
	  requirements set forth by a set of well-identified trusted authorities.

endif
```
